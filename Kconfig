## Kconfig
```kconfig
menuconfig ZMK_BEHAVIOR_CLK_OR_KEY
    bool "Click-or-key behavior (Keyball44-style typing mode)"
    default y
    help
      Enable custom behavior that acts as a mouse click in mouse mode,
      but as a keyboard key in typing mode. Includes vowel auto-complete
      for Japanese romaji input.

if ZMK_BEHAVIOR_CLK_OR_KEY

choice ZMK_CLK_OR_KEY_PINCH_MODIFIER
    prompt "Modifier used for scroll + left-click pinch"
    default ZMK_CLK_OR_KEY_PINCH_MODIFIER_LGUI
    help
      Modifier held when left-click is pressed while scroll mode is active.
      The default keeps the current Mac/Figma pinch-zoom behavior.

config ZMK_CLK_OR_KEY_PINCH_MODIFIER_LGUI
    bool "Left GUI"

config ZMK_CLK_OR_KEY_PINCH_MODIFIER_LCTL
    bool "Left Control"

config ZMK_CLK_OR_KEY_PINCH_MODIFIER_LSFT
    bool "Left Shift"

config ZMK_CLK_OR_KEY_PINCH_MODIFIER_LALT
    bool "Left Alt"

endchoice

endif # ZMK_BEHAVIOR_CLK_OR_KEY

config ZMK_AML_TYPING_MODE_TIMEOUT
    int "AML typing mode vowel auto-complete timeout (ms)"
    default 300
    help
      Time window in milliseconds after a click where a vowel key will
      trigger auto-insertion of the preceding consonant (J/K/L).

menuconfig ZMK_BEHAVIOR_VOWEL_AUTO
    bool "Vowel autocomplete behavior (Keyball44 drag-scroll helper)"
    default y
    help
      Custom &kp wrapper for A/I/U/E/O that taps a recent J/K/L
      click-consonant via direct HID before raising the vowel event.

menuconfig ZMK_BEHAVIOR_BT_TOGGLE_01
    bool "BT profile toggle (0 <-> 1)"
    default y
    help
      Flip between BT profiles 0 and 1 on each activation. Handy for
      users who only rotate between two Bluetooth hosts.

menuconfig ZMK_BEHAVIOR_OS_AWARE
    bool "OS-aware key press behavior"
    default y
    help
      Picks one of two encoded keycodes to send based on the active BT
      profile (0 = Mac, others = Win/etc).

menuconfig ZMK_BEHAVIOR_OS_NEW_TAB_CLICK
    bool "OS-aware browser new-tab click behavior"
    default y
    help
      Sends Command+left-click on BT profile 0 (Mac), and Control+left-click
      on any other BT profile (Windows/browser profile).

if ZMK_BEHAVIOR_OS_NEW_TAB_CLICK

config ZMK_OS_NEW_TAB_CLICK_MOD_SETTLE_MS
    int "Delay after pressing the browser new-tab click modifier"
    default 30
    range 0 200
    help
      Delay in milliseconds between sending Command/Control and sending the
      left click. Windows over BLE can otherwise treat the click as unmodified.

config ZMK_OS_NEW_TAB_CLICK_HOLD_MS
    int "Browser new-tab click button hold time"
    default 20
    range 0 200
    help
      Delay in milliseconds between mouse button press and release.

endif # ZMK_BEHAVIOR_OS_NEW_TAB_CLICK

menuconfig ZMK_BEHAVIOR_OS_AWARE_MCLK_OR_TOG
    bool "OS-aware middle-click or layer toggle behavior"
    default y
    help
      Acts as middle click on BT profile 0 (Mac), and toggles a target
      layer on any other BT profile (Windows/game profile).

menuconfig ZMK_INPUT_PROCESSOR_TYPING_MODE_EXIT
    bool "Trackball motion typing-mode exit input processor"
    default y
    help
      Exit custom typing mode on REL_X/REL_Y trackball movement.

menuconfig ZMK_INPUT_PROCESSOR_SCROLL_MODE
    bool "Scroll-mode input processor (Keyball44 drag-scroll port)"
    default y
    help
      Convert trackball REL_X/REL_Y events into REL_HWHEEL/REL_WHEEL
      while the global scroll mode is active. Works with clk_or_key's
      scroll trigger (param2 = 0xFF) and fixed-scroll lock.

if ZMK_INPUT_PROCESSOR_SCROLL_MODE

config ZMK_SCROLL_MODE_DIVISOR_X
    int "Horizontal scroll divisor"
    default 50
    range 1 1000
    help
      Trackball motion units per horizontal scroll tick.

config ZMK_SCROLL_MODE_DIVISOR_Y
    int "Vertical scroll divisor"
    default 50
    range 1 1000
    help
      Trackball motion units per vertical scroll tick.

config ZMK_SCROLL_MODE_SNAP_BUFFER_LEN
    int "Scroll snap history length"
    default 5
    range 1 31
    help
      Number of recent samples used to decide the dominant scroll axis.

config ZMK_SCROLL_MODE_NATURAL_SCROLL
    bool "Use natural vertical scroll direction"
    default y
    help
      Match the current behavior: trackball down scrolls content down.

config ZMK_SCROLL_MODE_CLEAR_SUPPRESSED_ACCUM
    bool "Clear suppressed scroll-axis accumulator"
    default y
    help
      Clear the accumulator for the axis currently suppressed by scroll
      snap. Disable this to restore the previous behavior, where suppressed
      movement could accumulate and emit if the snap direction changed.

endif # ZMK_INPUT_PROCESSOR_SCROLL_MODE
```

## dts/bindings/behaviors/zmk,behavior-bt-toggle-01.yaml
```yaml
description: |
  Toggle the active BT profile between 0 and 1.

compatible: "zmk,behavior-bt-toggle-01"

include: zero_param.yaml
```

## dts/bindings/behaviors/zmk,behavior-os-aware-mclk-or-tog.yaml
```yaml
description: |
  OS-aware middle-click or layer toggle. Profile 0 acts as middle click;
  other profiles toggle the layer passed as param1.

compatible: "zmk,behavior-os-aware-mclk-or-tog"

include: one_param.yaml
```

## dts/bindings/behaviors/zmk,behavior-os-aware.yaml
```yaml
description: |
  OS-aware key press: param1 fires when BT profile 0 is active (Mac),
  param2 fires for any other profile.

compatible: "zmk,behavior-os-aware"

include: two_param.yaml
```

## dts/bindings/behaviors/zmk,behavior-os-new-tab-click.yaml
```yaml
description: |
  OS-aware browser new-tab click. Profile 0 sends Command+left-click;
  other profiles send Control+left-click.

compatible: "zmk,behavior-os-new-tab-click"

include: zero_param.yaml
```

## dts/bindings/input_processors/zmk,input-processor-typing-mode-exit.yaml
```yaml
description: |
  Trackball motion hook for AML typing mode.
  Exits typing mode on REL_X/REL_Y movement and passes the original
  movement through unchanged.

compatible: "zmk,input-processor-typing-mode-exit"

include: ip_zero_param.yaml
```
